## yocto/meta-onekiwi-hud/conf/layer.conf
```bitbake
BBPATH .= ":${LAYERDIR}"
BBFILES += "${LAYERDIR}/recipes-*/*/*.bb ${LAYERDIR}/recipes-*/*/*.bbappend"

BBFILE_COLLECTIONS += "onekiwi-hud"
BBFILE_PATTERN_onekiwi-hud = "^${LAYERDIR}/"
BBFILE_PRIORITY_onekiwi-hud = "8"

LAYERVERSION_onekiwi-hud = "1"
LAYERSERIES_COMPAT_onekiwi-hud = "dunfell"
```
